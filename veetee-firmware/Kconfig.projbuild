## veetee-firmware/Kconfig.projbuild
```kconfig
menu "Veetee firmware"

config VEETEE_BOARD_PROFILE
    string "Verified board profile identifier"
    default ""
    help
        Identifier resolved from the operator-supplied board manifest. An empty
        value keeps the firmware in bring-up mode and must not be flashed to a
        physical board.

config VEETEE_PROTOCOL_PROFILE
    int "WebSocket protocol profile"
    range 1 3
    default 3
    help
        3 is the product default. 1 and 2 are explicit compatibility profiles.

endmenu
```

## veetee-firmware/main/Kconfig.projbuild
```kconfig
menu "Veetee firmware"

config VEETEE_BOARD_PROFILE
    string "Verified board profile identifier"
    default ""
    help
        Identifier resolved from the operator-supplied board manifest. An empty
        value keeps the firmware in bring-up mode and must not be flashed to a
        physical board.

config VEETEE_PROTOCOL_PROFILE
    int "WebSocket protocol profile"
    range 1 3
    default 3
    help
        3 is the product default. 1 and 2 are explicit compatibility profiles.

config VEETEE_WS_URI
    string "Veetee WebSocket URI"
    default ""
    help
        Runtime endpoint. Keep empty until an operator provisions a LAN/TLS
        endpoint; the firmware must not invent a host address.

config VEETEE_WIFI_SSID
    string "Optional station SSID for first provisioning"
    default ""
    help
        Used only when the NVS station profile has no SSID. Keep empty to
        preserve the existing NVS profile and never log this value.

config VEETEE_WIFI_PASSWORD
    string "Optional station password for first provisioning"
    default ""
    help
        Used only with VEETEE_WIFI_SSID when the NVS profile is empty. This is
        a local build input and must not be committed or printed in logs.

config VEETEE_WIFI_OVERRIDE_NVS
    bool "Override saved NVS station profile"
    default n
    help
        Use only for an explicit local provisioning test. When disabled, a
        non-empty NVS SSID always wins over build-time values.

config VEETEE_AP_SSID_PREFIX
    string "Wi-Fi provisioning network prefix"
    default "Veetee"
    help
        Prefix for the temporary local setup network. The firmware appends a
        masked device suffix; do not include secrets or a user identity.

config VEETEE_AP_CHANNEL
    int "Wi-Fi provisioning channel"
    range 1 13
    default 6
    help
        Channel used only while the local setup SoftAP is active.

config VEETEE_ENABLE_HARDWARE
    bool "Enable verified board audio and PTT hardware"
    default n
    help
        Enable only after the board profile has been verified. Host builds do
        not use this option.

config VEETEE_MCP_ENABLED
    bool "Enable bounded device MCP owner task"
    default n
    help
        Accept MCP requests on a bounded owner task. Hardware descriptors are
        still supplied by the board capability manifest; enabling this option
        does not invent or advertise a tool.

config VEETEE_MCP_QUEUE_DEPTH
    int "MCP request queue depth"
    range 1 8
    default 2
    depends on VEETEE_MCP_ENABLED
    help
        Number of complete bounded MCP JSON envelopes held while the owner
        task runs. Reject new requests when the queue is full.

config VEETEE_MCP_TASK_STACK
    int "MCP owner task stack size (bytes)"
    range 4096 16384
    default 12288
    depends on VEETEE_MCP_ENABLED
    help
        cJSON parsing and bounded response serialization happen in the owner
        task. Tune only with stack high-water evidence on the target board.

config VEETEE_MCP_TASK_PRIORITY
    int "MCP owner task priority"
    range 1 24
    default 14
    depends on VEETEE_MCP_ENABLED
    help
        Relative FreeRTOS priority for bounded MCP parsing/dispatch. Keep it
        below audio capture/output deadlines and verify queue age on hardware.

config VEETEE_WAKE_ENABLED
    bool "Enable on-device wake word"
    default n
    depends on VEETEE_ENABLE_HARDWARE
    help
        Keep microphone processing local while the device is idle. The selected
        model is packed into the model partition by ESP-SR. If initialization
        fails at boot, PTT remains available.

choice VEETEE_WAKE_MODEL
    prompt "Wake word model"
    default VEETEE_WAKE_MODEL_COMPUTER_TTS
    depends on VEETEE_WAKE_ENABLED

config VEETEE_WAKE_MODEL_COMPUTER_TTS
    bool "Computer (ESP-SR English test preset)"

config VEETEE_WAKE_MODEL_HIESP
    bool "Hi,ESP (ESP-SR preset)"

endchoice

config VEETEE_WAKE_MODEL_NAME
    string "Wake word model identifier"
    default "wn9_computer_tts" if VEETEE_WAKE_MODEL_COMPUTER_TTS
    default "wn9_hiesp" if VEETEE_WAKE_MODEL_HIESP
    depends on VEETEE_WAKE_ENABLED
    help
        The exact ESP-SR model identifier. Keep this in the config/asset
        manifest; conversation code must not contain a wake phrase literal.

config VEETEE_WAKE_MODEL_PARTITION
    string "Wake model partition label"
    default "model"
    depends on VEETEE_WAKE_ENABLED

config VEETEE_WAKE_DETECTION_MODE
    int "WakeNet detection mode (90 or 95)"
    range 90 95
    default 90
    depends on VEETEE_WAKE_ENABLED

config VEETEE_WAKE_THRESHOLD_PERCENT
    int "WakeNet threshold percent"
    range 40 99
    default 65
    depends on VEETEE_WAKE_ENABLED
    help
        The default matches the selected Computer model manifest's calibrated
        0.648-0.650 threshold. Tune per signed model asset; do not use a
        generic high threshold that makes the configured phrase unreachable.

config VEETEE_WAKE_INPUT_BUFFER_SAMPLES
    int "Wake input buffer samples"
    range 1024 16384
    default 4096
    depends on VEETEE_WAKE_ENABLED

config VEETEE_AEC_ENABLED
    bool "Enable playback-reference acoustic echo cancellation"
    default n
    depends on VEETEE_ENABLE_HARDWARE
    help
        Use the ESP-SR full-duplex AEC adapter with one microphone and one
        downlink playback reference. If initialization fails at boot, the
        firmware keeps the PTT/half-duplex path and reports the failure.

config VEETEE_AEC_FILTER_LENGTH
    int "AEC adaptive filter length"
    range 2 8
    default 4
    depends on VEETEE_AEC_ENABLED
    help
        ESP32-S3 recommendation is four. Larger values cost more CPU and
        memory; keep this in the board profile rather than source code.

config VEETEE_AEC_REFERENCE_BUFFER_MS
    int "AEC far-end reference buffer duration (ms)"
    range 100 2000
    default 500
    depends on VEETEE_AEC_ENABLED
    help
        Bound the 16 kHz playback-reference ring. It is flushed on abort or
        turn ownership change so stale speaker audio cannot enter a new turn.

config VEETEE_AEC_REFERENCE_DELAY_MS
    int "AEC playback-reference alignment delay (ms)"
    range 0 500
    default 80
    depends on VEETEE_AEC_ENABLED
    help
        Minimum 16 kHz reference samples retained before the AEC consumes them.
        Tune for the verified board I2S/DMA path; this is not an echo-quality
        guarantee. Zero preserves the pre-alignment behavior.

config VEETEE_WAKE_DURING_PLAYBACK
    bool "Allow wake detection while speaker plays"
    default n
    depends on VEETEE_WAKE_ENABLED && VEETEE_AEC_ENABLED
    help
        Enable only after a verified playback-reference AEC/duplex path is
        available. The default half-duplex policy prevents speaker output from
        contaminating the on-device wake detector.

config VEETEE_AEC_PROCESS_WAKE
    bool "Apply AEC to wake detector input"
    default y
    depends on VEETEE_WAKE_DURING_PLAYBACK
    help
        Keep enabled for the product path. Disable only for a bounded diagnostic
        comparison that keeps WakeNet active during playback but bypasses the
        AEC transform; do not promote that configuration to a product build.

config VEETEE_PTT_GPIO
    int "Push-to-talk GPIO"
    default -1

config VEETEE_PTT_ACTIVE_LEVEL
    int "Push-to-talk active level"
    range 0 1
    default 0

config VEETEE_MIC_BCLK_GPIO
    int "Microphone I2S BCLK GPIO"
    default -1

config VEETEE_MIC_WS_GPIO
    int "Microphone I2S WS GPIO"
    default -1

config VEETEE_MIC_DIN_GPIO
    int "Microphone I2S DIN GPIO"
    default -1

config VEETEE_SPK_BCLK_GPIO
    int "Speaker I2S BCLK GPIO"
    default -1

config VEETEE_SPK_WS_GPIO
    int "Speaker I2S WS GPIO"
    default -1

config VEETEE_SPK_DOUT_GPIO
    int "Speaker I2S DOUT GPIO"
    default -1

config VEETEE_MIC_SAMPLE_RATE
    int "Microphone sample rate"
    range 8000 48000
    default 16000

config VEETEE_SPK_SAMPLE_RATE
    int "Speaker sample rate"
    range 8000 48000
    default 24000

config VEETEE_AUDIO_FRAME_DURATION_MS
    int "Opus frame duration"
    range 20 120
    default 60

config VEETEE_NOISE_SUPPRESSION_ENABLED
    bool "Enable on-device noise suppression"
    default n
    depends on VEETEE_ENABLE_HARDWARE
    help
        Run the ESP-SR single-microphone noise suppressor before WakeNet and
        uplink encoding. The current board is simplex I2S, so this option does
        not provide acoustic echo cancellation; AEC requires a verified
        playback-reference channel and remains a separate promotion gate.

config VEETEE_NOISE_SUPPRESSION_MODE
    int "Noise suppression strength"
    range 0 2
    default 1
    depends on VEETEE_NOISE_SUPPRESSION_ENABLED
    help
        ESP-SR mode: 0 mild, 1 medium, 2 aggressive. Keep this in the board
        configuration so model/strength changes do not require source edits.

config VEETEE_PLAYBACK_QUEUE_DEPTH
    int "Downlink Opus playback queue depth"
    range 4 64
    default 32
    help
        Number of encoded downlink frames buffered while the I2S decoder
        catches up with a streaming TTS burst. Increase only when PSRAM and
        internal heap headroom have been measured on the target board.

config VEETEE_AUDIO_DIAGNOSTICS
    bool "Log bounded microphone level diagnostics"
    default n
    depends on VEETEE_ENABLE_HARDWARE
    help
        Log rate-limited sample count, peak and mean absolute level only. No
        PCM, transcript or microphone content is logged. Enable temporarily
        for physical audio bring-up; keep disabled in normal builds.

config VEETEE_LCD_ENABLED
    bool "Enable ST7789 LCD"
    default n

config VEETEE_LCD_SPI_HOST
    int "LCD SPI host"
    range 1 2
    default 2

config VEETEE_LCD_WIDTH
    int "LCD width"
    range 1 1024
    default 240

config VEETEE_LCD_HEIGHT
    int "LCD height"
    range 1 1024
    default 280

config VEETEE_LCD_OFFSET_X
    int "LCD offset X"
    range 0 1024
    default 0

config VEETEE_LCD_OFFSET_Y
    int "LCD offset Y"
    range 0 1024
    default 20

config VEETEE_LCD_MOSI_GPIO
    int "LCD MOSI GPIO"
    range 0 48
    default 47

config VEETEE_LCD_SCLK_GPIO
    int "LCD SCLK GPIO"
    range 0 48
    default 21

config VEETEE_LCD_DC_GPIO
    int "LCD DC GPIO"
    range 0 48
    default 40

config VEETEE_LCD_RESET_GPIO
    int "LCD reset GPIO"
    range 0 48
    default 45

config VEETEE_LCD_CS_GPIO
    int "LCD CS GPIO"
    range 0 48
    default 41

config VEETEE_LCD_BACKLIGHT_GPIO
    int "LCD backlight GPIO"
    range 0 48
    default 42

config VEETEE_LCD_BACKLIGHT_ACTIVE_LEVEL
    int "LCD backlight active level"
    range 0 1
    default 1

config VEETEE_LCD_SPI_MODE
    int "LCD SPI mode"
    range 0 3
    default 0

config VEETEE_LCD_INVERT_COLOR
    bool "Invert LCD colors"
    default y

config VEETEE_LCD_RGB_ORDER_BGR
    bool "Use BGR LCD color order"
    default n

config VEETEE_LCD_MIRROR_X
    bool "Mirror LCD X"
    default n

config VEETEE_LCD_MIRROR_Y
    bool "Mirror LCD Y"
    default n

config VEETEE_LCD_SWAP_XY
    bool "Swap LCD axes"
    default n

config VEETEE_BOOT_CHIME_ENABLED
    bool "Play startup chime"
    default n

config VEETEE_BOOT_CHIME_FIRST_HZ
    int "Startup chime first frequency"
    range 100 4000
    default 880

config VEETEE_BOOT_CHIME_SECOND_HZ
    int "Startup chime second frequency"
    range 100 4000
    default 1175

config VEETEE_BOOT_CHIME_TONE_MS
    int "Startup chime tone duration"
    range 20 500
    default 90

config VEETEE_BOOT_CHIME_GAP_MS
    int "Startup chime gap"
    range 0 500
    default 35

config VEETEE_BOOT_CHIME_AMPLITUDE
    int "Startup chime amplitude"
    range 100 30000
    default 9000

endmenu
```

## veetee-firmware/sdkconfig.defaults
```kconfig
CONFIG_ESPTOOLPY_FLASHSIZE_16MB=y
CONFIG_ESPTOOLPY_FLASHSIZE="16MB"
CONFIG_ESP32S3_DEFAULT_CPU_FREQ_240=y
CONFIG_ESP_MAIN_TASK_STACK_SIZE=8192
# ESP32-S3 N16R8 board profile: keep Octal PSRAM available for audio/model
# allocations even when the optional WakeNet feature is disabled.
CONFIG_SPIRAM=y
CONFIG_SPIRAM_MODE_OCT=y
CONFIG_SPIRAM_SPEED_80M=y
CONFIG_SPIRAM_MALLOC_ALWAYSINTERNAL=2048
CONFIG_SPIRAM_MALLOC_RESERVE_INTERNAL=98304
CONFIG_SPIRAM_MEMTEST=n
CONFIG_FREERTOS_HZ=1000
CONFIG_LOG_DEFAULT_LEVEL_INFO=y
CONFIG_PARTITION_TABLE_CUSTOM=y
CONFIG_PARTITION_TABLE_CUSTOM_FILENAME="partitions.csv"
CONFIG_VEETEE_BOARD_PROFILE="bread-compact-wifi-lcd"
CONFIG_VEETEE_PROTOCOL_PROFILE=3
CONFIG_VEETEE_WS_TASK_STACK=4096
CONFIG_VEETEE_WS_BUFFER_SIZE=4096
CONFIG_VEETEE_AP_SSID_PREFIX="Veetee"
CONFIG_VEETEE_AP_CHANNEL=6
CONFIG_VEETEE_ENABLE_HARDWARE=y
CONFIG_VEETEE_WAKE_ENABLED=y
CONFIG_VEETEE_WAKE_MODEL_COMPUTER_TTS=y
CONFIG_VEETEE_WAKE_MODEL_NAME="wn9_computer_tts"
CONFIG_VEETEE_WAKE_MODEL_PARTITION="model"
CONFIG_VEETEE_WAKE_DETECTION_MODE=90
CONFIG_VEETEE_WAKE_THRESHOLD_PERCENT=65
CONFIG_VEETEE_WAKE_INPUT_BUFFER_SAMPLES=4096
CONFIG_VEETEE_AEC_ENABLED=y
CONFIG_VEETEE_AEC_FILTER_LENGTH=4
CONFIG_VEETEE_AEC_REFERENCE_BUFFER_MS=500
CONFIG_VEETEE_AEC_REFERENCE_DELAY_MS=80
CONFIG_VEETEE_WAKE_DURING_PLAYBACK=y
CONFIG_VEETEE_AEC_PROCESS_WAKE=y
# Keep WebSocket RX/control and TX paths on separate ESP-IDF locks. This avoids
# duplex audio frames waiting behind a receive-side callback or keepalive.
CONFIG_ESP_WS_CLIENT_SEPARATE_TX_LOCK=y
CONFIG_VEETEE_PTT_GPIO=0
CONFIG_VEETEE_PTT_ACTIVE_LEVEL=0
CONFIG_VEETEE_MIC_BCLK_GPIO=5
CONFIG_VEETEE_MIC_WS_GPIO=4
CONFIG_VEETEE_MIC_DIN_GPIO=6
CONFIG_VEETEE_SPK_BCLK_GPIO=15
CONFIG_VEETEE_SPK_WS_GPIO=16
CONFIG_VEETEE_SPK_DOUT_GPIO=7
CONFIG_VEETEE_MIC_SAMPLE_RATE=16000
CONFIG_VEETEE_SPK_SAMPLE_RATE=24000
CONFIG_VEETEE_AUDIO_FRAME_DURATION_MS=60
CONFIG_VEETEE_NOISE_SUPPRESSION_ENABLED=y
CONFIG_VEETEE_NOISE_SUPPRESSION_MODE=1
CONFIG_VEETEE_PLAYBACK_QUEUE_DEPTH=32
CONFIG_SR_WN_WN9_COMPUTER_TTS=y
CONFIG_VEETEE_MCP_ENABLED=y
CONFIG_VEETEE_MCP_CAPABILITY_REVISION=1
CONFIG_VEETEE_MCP_QUEUE_DEPTH=2
CONFIG_VEETEE_MCP_TASK_STACK=12288
CONFIG_VEETEE_MCP_TASK_PRIORITY=14
CONFIG_VEETEE_BOARD_STATUS_LED_GPIO=48
CONFIG_VEETEE_BOARD_LAMP_GPIO=18
CONFIG_VEETEE_BOARD_STATUS_LED_ACTIVE_LEVEL=1
CONFIG_VEETEE_BOARD_LAMP_ACTIVE_LEVEL=1
CONFIG_VEETEE_BOARD_STATUS_LED_RGB=y
CONFIG_VEETEE_LCD_ENABLED=y

# LVGL is used as the firmware UI runtime; example/demo applications are not
# shipped in the product image.
CONFIG_LV_BUILD_EXAMPLES=n
CONFIG_LV_BUILD_DEMOS=n
CONFIG_VEETEE_LCD_SPI_HOST=2
CONFIG_VEETEE_LCD_WIDTH=240
CONFIG_VEETEE_LCD_HEIGHT=280
CONFIG_VEETEE_LCD_OFFSET_X=0
CONFIG_VEETEE_LCD_OFFSET_Y=20
CONFIG_VEETEE_LCD_MOSI_GPIO=47
CONFIG_VEETEE_LCD_SCLK_GPIO=21
CONFIG_VEETEE_LCD_DC_GPIO=40
CONFIG_VEETEE_LCD_RESET_GPIO=45
CONFIG_VEETEE_LCD_CS_GPIO=41
CONFIG_VEETEE_LCD_BACKLIGHT_GPIO=42
CONFIG_VEETEE_LCD_BACKLIGHT_ACTIVE_LEVEL=1
CONFIG_VEETEE_LCD_SPI_MODE=0
CONFIG_VEETEE_LCD_INVERT_COLOR=y
# CONFIG_VEETEE_LCD_RGB_ORDER_BGR is not set
# CONFIG_VEETEE_LCD_MIRROR_X is not set
# CONFIG_VEETEE_LCD_MIRROR_Y is not set
# CONFIG_VEETEE_LCD_SWAP_XY is not set
CONFIG_VEETEE_BOOT_CHIME_ENABLED=y
CONFIG_VEETEE_BOOT_CHIME_FIRST_HZ=880
CONFIG_VEETEE_BOOT_CHIME_SECOND_HZ=1175
CONFIG_VEETEE_BOOT_CHIME_TONE_MS=90
CONFIG_VEETEE_BOOT_CHIME_GAP_MS=35
CONFIG_VEETEE_BOOT_CHIME_AMPLITUDE=9000
```
